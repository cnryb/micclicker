## firmware/c3/main/Kconfig
```kconfig
menu "MicClicker C3"

choice MICCLICKER_C3_ROLE
    prompt "C3 firmware role"
    default MICCLICKER_ROLE_AUDIO_LINK

config MICCLICKER_ROLE_AUDIO_LINK
    bool "Audio link (capture, G.722 encode, ESP-NOW send)"
    help
        The stage-4 product role: capture 16 kHz mono from the ES8311, encode one
        20 ms G.722 frame per ESP-NOW packet, and send it to the bound S3 peer over
        encrypted unicast. Pairs on first boot when no binding exists.

config MICCLICKER_ROLE_SELFTEST
    bool "Hardware selftest (Wi-Fi scan, ADC buttons, G.722 vector)"
    help
        The stage-1 selftest: scans Wi-Fi, then prompts for the four button states and
        reports ADC voltages. Needs a human at the device. It does not touch the codec,
        the radio link or NVS bindings.

config MICCLICKER_ESPNOW_PROBE_SENDER
    bool "ESP-NOW probe sender (stage 3 measurement)"
    help
        The stage-3 probe: discovery, burst audio, paced audio, key retransmission,
        pairing and an encrypted round trip. Erases any stored binding on every boot,
        which product roles must never do. Selected by `./firmware/build.sh c3 --probe`.

endchoice

config MICCLICKER_ESPNOW_PROBE_CHANNEL
    int "ESP-NOW probe channel (2.4 GHz)"
    range 1 13
    default 1
    depends on MICCLICKER_ESPNOW_PROBE_SENDER
    help
        Both ends must use the same channel. The probe logs the channel it actually
        reached, so a mismatch shows up in the logs rather than only as silence.

config MICCLICKER_PAIR_ON_BOOT
    bool "Open a pairing window on boot when no binding is stored"
    default y
    depends on MICCLICKER_ROLE_AUDIO_LINK
    help
        When no pairing record exists, the C3 broadcasts one pairing request window at
        boot. Disable to require an explicit pairing gesture instead; with this off and
        no binding the device captures and encodes but never sends, which is useful for
        measuring the sender alone.

endmenu
```

## firmware/s3/main/Kconfig
```kconfig
menu "MicClicker S3"

config MICCLICKER_STAGE1_SELFTEST
    bool "Run stage 1 hardware selftests instead of the USB prototype"
    default n
    help
        Keep the PSRAM, Wi-Fi, ADC and pairing-input probes available without
        including them in the default USB composite-device build.

config MICCLICKER_ESPNOW_PROBE_RECEIVER
    bool "Run the ESP-NOW probe as the receiver instead of the USB prototype"
    default n
    depends on !MICCLICKER_STAGE1_SELFTEST
    help
        Replaces the USB composite device with the stage-3 ESP-NOW probe receiver.
        Pair with the C3 sender probe on the same channel. The probe does not
        enumerate USB, so the board is reachable only over the CH343 console.

config MICCLICKER_LED_GPIO
    int "GPIO driving the onboard addressable RGB LED"
    range 0 48
    default 48
    help
        Data line of the board's single-wire RGB LED. Measured on the
        ESP32-S3-N16R8 board as GPIO48, which is also the pin the factory
        Arduino demo drove through RGB_BUILTIN. The product firmware sends a
        black frame here at boot, so the LED is dark unless something asks for
        a colour.

config MICCLICKER_ESPNOW_PROBE_CHANNEL
    int "ESP-NOW probe channel (2.4 GHz)"
    range 1 13
    default 1
    depends on MICCLICKER_ESPNOW_PROBE_RECEIVER
    help
        Both ends must use the same channel.

endmenu
```
